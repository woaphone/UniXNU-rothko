## configs/rothko_defconfig
```kconfig
# UniXNU rothko kernel profile, paired with patches/xnu/series.
CONFIG_XNU_SOURCE_CORECRYPTO14=y
CONFIG_XNU_SOURCE_PTHREAD=y
CONFIG_XNU_ARM_DT_PLATFORM=y
CONFIG_XNU_ARMCPU=y
CONFIG_XNU_NATIVE_AES=y
CONFIG_XNU_NATIVE_UFS=y
CONFIG_XNU_NATIVE_RAM_BLOCK=y
CONFIG_XNU_NATIVE_CS_HASH_CACHE=y
CONFIG_XNU_TRUST_CACHE_RUNTIME=y
CONFIG_XNU_NATIVE_ARCH_TIMER=y
CONFIG_XNU_NATIVE_PAN=y
CONFIG_XNU_NATIVE_MOBILE_DISPLAY=y
CONFIG_XNU_NATIVE_HID_INPUT=y
CONFIG_XNU_NATIVE_KEYSTORE_EVENTS=y
CONFIG_XNU_NATIVE_MTK_CPU_FREQ=y
CONFIG_XNU_NATIVE_LEGACY_DISPLAY=n
CONFIG_XNU_NATIVE_ADRENO=n
CONFIG_XNU_ARMVIRT_PLATFORM=n
CONFIG_XNU_NATIVE_VIRTIO_BLOCK=n
CONFIG_XNU_SHENG_PMGR=n
CONFIG_XNU_VERIFIED_ROOT_PROBE=n
CONFIG_XNU_OWNER_ROOT_AUDIT=n
CONFIG_XNU_OWNER_DATA_MOUNT=n
CONFIG_XNU_NATIVE_SETUP_INIT=n
CONFIG_XNU_CRYPTO_BOOTSTRAP="prelinked"
CONFIG_XNU_OWNER_DATA_VOLUME_UUID="04769D26-2CA0-4825-B443-E2E5F88300F2"
CONFIG_XNU_EXTRA_LD_ARCHIVES=""
```
